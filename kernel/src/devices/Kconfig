## kernel/src/devices/Kconfig
```kconfig
# General Device Configuration

config SPI_CORE
    default n
    bool "enable spi core"

config I2C_CORE
    default n
    bool "enable i2c core"

config SPI_FLASH_SECTOR_SIZE
    int "SPI flash logical sector size"
    default 512
    range 1 65535
    depends on ENABLE_BLOCK

config SPI_FLASH_PAGE_SIZE
    int "SPI flash page size"
    default 256
    range 1 65536
    depends on ENABLE_BLOCK

choice
    prompt "SPI flash erase size"
    default SPI_FLASH_ERASE_SIZE_4K
    depends on ENABLE_BLOCK

config SPI_FLASH_ERASE_SIZE_4K
    bool "4 KiB"

config SPI_FLASH_ERASE_SIZE_32K
    bool "32 KiB"

config SPI_FLASH_ERASE_SIZE_64K
    bool "64 KiB"

endchoice

config SPI_FLASH_ERASE_SIZE
    int
    default 4096 if SPI_FLASH_ERASE_SIZE_4K
    default 32768 if SPI_FLASH_ERASE_SIZE_32K
    default 65536 if SPI_FLASH_ERASE_SIZE_64K

config SPI_FLASH_MAX_CAPACITY
    int "Maximum SPI flash capacity using 3-byte addresses"
    default 16777216
    range 1 16777216
    depends on ENABLE_BLOCK

config SPI_FLASH_ERASE_CACHE_SLOTS
    int "SPI flash erase cache slots"
    default 2
    range 1 4
    depends on ENABLE_BLOCK

config SPI_FLASH_STATUS_POLL_INTERVAL_US
    int "SPI flash status polling interval in microseconds"
    default 20
    range 1 1000000
    depends on ENABLE_BLOCK

config SPI_FLASH_PAGE_PROGRAM_TIMEOUT_MS
    int "SPI flash page program timeout in milliseconds"
    default 5
    range 1 60000
    depends on ENABLE_BLOCK

config SPI_FLASH_SECTOR_ERASE_TIMEOUT_MS
    int "SPI flash sector erase timeout in milliseconds"
    default 500
    range 1 60000
    depends on ENABLE_BLOCK

config SPI_FLASH_BLOCK_ERASE_32K_TIMEOUT_MS
    int "SPI flash 32 KiB erase timeout in milliseconds"
    default 2000
    range 1 60000
    depends on ENABLE_BLOCK

config SPI_FLASH_BLOCK_ERASE_64K_TIMEOUT_MS
    int "SPI flash 64 KiB erase timeout in milliseconds"
    default 3000
    range 1 60000
    depends on ENABLE_BLOCK

config SPI_FLASH_CHIP_ERASE_TIMEOUT_MS
    int "SPI flash chip erase timeout in milliseconds"
    default 200000
    range 1 600000
    depends on ENABLE_BLOCK

config ESP32_FLASH_SECTOR_SIZE
    int "ESP32 internal flash sector size"
    default 4096

config ESP32_FLASH_PAGE_SIZE
    int "ESP32 internal flash page size"
    default 256

config ESP32_FLASH_BLOCK_64K_SIZE
    int "ESP32 internal flash 64 KiB block size"
    default 65536

config ESP32_FLASH_READ_CHUNK_SIZE
    int "ESP32 internal flash read chunk size"
    default 1024

config ESP32_LOADABLE_REGION_BASE
    hex "Loadable flash region base"
    default 0x00110000 if SOC_ESP32C3
    default 0x00200000 if SOC_ESP32C6

config ESP32_LOADABLE_REGION_SIZE
    hex "Loadable flash region size"
    default 0x002F0000 if SOC_ESP32C3
    default 0x00300000 if SOC_ESP32C6
```
